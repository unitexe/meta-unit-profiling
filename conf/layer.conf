## conf/layer.conf
```bitbake
BBPATH .= ":${LAYERDIR}"

BBFILES += "${LAYERDIR}/recipes*/*/*.bb ${LAYERDIR}/recipes*/*/*.bbappend"

BBFILE_COLLECTIONS += "meta-unit-profiling"
BBFILE_PATTERN_meta-unit-profiling := "^${LAYERDIR}/"
BBFILE_PRIORITY_meta-unit-profiling = "13"

LAYERDEPENDS_meta-unit-profiling = "core openembedded-layer"

LAYERSERIES_COMPAT_meta-unit-profiling = "scarthgap styhead walnascar"

UNIT_PROFILING_LAYERDIR = "${LAYERDIR}"

BBFILES_DYNAMIC += " \
    freescale-layer:${LAYERDIR}/dynamic-layers/freescale-layer/*/*/*.bb \
    freescale-layer:${LAYERDIR}/dynamic-layers/freescale-layer/*/*/*.bbappend \
    raspberrypi-layer:${LAYERDIR}/dynamic-layers/raspberrypi-layer/*/*/*.bb \
    raspberrypi-layer:${LAYERDIR}/dynamic-layers/raspberrypi-layer/*/*/*.bbappend \
"
```
